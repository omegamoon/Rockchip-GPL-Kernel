## drivers/video/Kconfig.tmp
```kconfig
#
# Video configuration
#

menu "Graphics support"
	depends on HAS_IOMEM

config HAVE_FB_ATMEL
	bool

config SH_MIPI_DSI
	tristate
	depends on (SUPERH || ARCH_SHMOBILE) && HAVE_CLK

config SH_LCD_MIPI_DSI
	bool

source "drivers/char/agp/Kconfig"

source "drivers/gpu/vga/Kconfig"

source "drivers/gpu/drm/Kconfig"

source "drivers/gpu/stub/Kconfig"

source "drivers/gpu/ion/Kconfig"
# Omegamoon >> Added mali support
source "drivers/gpu/mali/Kconfig"
config VGASTATE
       tristate
       default n
```
